## kernel-4.9/drivers/input/touchscreen/mediatek/Kconfig
```kconfig
#
# Touchscreen driver configuration
#
menuconfig INPUT_TOUCHSCREEN
	bool "Touchscreens"
	help
	  Say Y here, and a list of supported touchscreens will be displayed.
	  This option doesn't affect the kernel.

	  If unsure, say Y.

if INPUT_TOUCHSCREEN

config TOUCHSCREEN_MTK
	bool "MediaTek Touch Panel Driver"
	help
	  Say Y here if you have MediaTek touch panel.

	  If unsure, say N.

	  To compile this dirver as a module, choose M here: the
	  module will be called.

config TOUCHSCREEN_PHYSICAL_ROTATION_WITH_LCM
	bool "MediaTek Touch Panel Rotation With LCM"
	default y
	help
	  Say N here if touch panel is not physical rotated as LCM does.
	  Physically rotated means that this driver will map
	  the reported coordination to diagonal position.

	  If unsure, say Y.
config TOUCHSCREEN_MTK_SOLOMON
	bool "SOLOMON for Mediatek package"
	default n
	help
	  Say Y here if you have SOLOMON touch panel.

	  If unsure, say N.

	  To compile this dirver as a module, choose M here: the
	  module will be called.

source "drivers/input/touchscreen/mediatek/SOLOMON/Kconfig"

config TOUCHSCREEN_MTK_FOCALTECH_TS
	bool "FOCALTECH_TS for Mediatek package"
	default n
	help
	  Say Y here if you have focaltech_touch touch panel.

	  If unsure, say N.

	  To compile this dirver as a module, choose M here: the
	  module will be called.

source "drivers/input/touchscreen/mediatek/focaltech_touch/Kconfig"
config TOUCHSCREEN_MTK_GT1151
	bool "GT1151 for Mediatek package"
	default n
	help
	  Say Y here if you have GT1151 touch panel.

	  If unsure, say N.

	  To compile this dirver as a module, choose M here: the
	  module will be called.

source "drivers/input/touchscreen/mediatek/GT1151/Kconfig"

config TOUCHSCREEN_CHIPONE
	bool "CHIPONE for Mediatek package"
	default n
	help
	  Say y here if you have chipone TDDI touch panel.
		
	  If unsure, say N.

	  To compile this driver as a module, choose M here: the
	  module will be called chipone-tddi.
#prize-add HX83112-pengzhipeng-20180829-start

config TOUCHSCREEN_MTK_HX83112
	bool "HX83112 for Mediatek package"
	default n
	help
	  Say Y here if you have HX83112 touch panel.

	  If unsure, say N.

	  To compile this dirver as a module, choose M here: the
	  module will be called.

source "drivers/input/touchscreen/mediatek/HX83112/Kconfig"

#prize-add HX83112-pengzhipeng-20180829-end

#prize-add FT8719P-pengzhipeng-20190225-start

config TOUCHSCREEN_MTK_FT8719P
	bool "FT8719P for Mediatek package"
	default n
	help
	  Say Y here if you have FT8719P touch panel.

	  If unsure, say N.

	  To compile this dirver as a module, choose M here: the
	  module will be called.

#prize-add FT8719P-pengzhipeng-20190225-end
config TOUCHSCREEN_MTK_NT36xxx
	bool "NT36xxx for Mediatek package"
	default n
	help
	  Say Y here if you have NT36xxx touch panel.

	  If unsure, say N.

	  To compile this dirver as a module, choose M here: the
	  module will be called.

source "drivers/input/touchscreen/mediatek/NT36xxx/Kconfig"


config TOUCHSCREEN_MTK_GT1X_V14
	bool "GT1X_V14 for Mediatek package"
	default n
	help
	  Say Y here if you have GT1X_V14 touch panel.
	  If unsure, say N.
	  To compile this dirver as a module, choose M here: the
	  module will be called.

source "drivers/input/touchscreen/mediatek/synaptics_dsx/Kconfig"

config TOUCHSCREEN_MTK_FOCALTECH_TS_V3
	bool "FT8006 for Mediatek package"
	default n
	help
	  Say Y here if you have FT8006 touch panel.
	  If unsure, say N.
	  To compile this dirver as a module, choose M here: the
	  module will be called.
	  
config TOUCHSCREEN_MTK_TLSC6X
	bool "TLSC6X for Mediatek package"
	default n
	help
	  Say Y here if you have TLSC6X touch panel.
	  If unsure, say N.
	  To compile this dirver as a module, choose M here: the
	  module will be called.	

	  
endif
```
