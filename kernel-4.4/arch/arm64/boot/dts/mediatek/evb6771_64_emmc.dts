/dts-v1/;
/plugin/;
#include <dt-bindings/interrupt-controller/irq.h>
#include <dt-bindings/interrupt-controller/arm-gic.h>
#include <dt-bindings/pinctrl/mt6771-pinfunc.h>

&reserved_memory {
	#address-cells = <2>;
	#size-cells = <2>;
	ranges;

	zmc-default {
		compatible = "mediatek,zone_movable_cma";
		size = <0 0xffc00000>;
		alignment = <0 0x10000000>;
		alloc-ranges = <0 0xc0000000 1 0x00000000>;
	};
};

/* chosen */
&chosen {
	/* fpga may has no lk, we need to specify display info here */
	/* fb buffer is reserved using this dts by memory node above */

	atag,videolfb-fb_base_l = <0x5e605000>;
	atag,videolfb-fb_base_h = <0x0>;
	atag,videolfb-islcmfound = <1>;
	atag,videolfb-islcm_inited = <0>;
	atag,videolfb-fps= <6000>;
	atag,videolfb-vramSize= <0x017bb000>;
	atag,videolfb-lcmname= "nt35595_fhd_dsi_cmd_truly_nt50358_drv";
};

&odm {
	led0:led@0 {
		compatible = "mediatek,red";
		led_mode = <0>;
		data = <1>;
		pwm_config = <0 0 0 0 0>;
	};
	led1:led@1 {
		compatible = "mediatek,green";
		led_mode = <0>;
		data = <1>;
		pwm_config = <0 0 0 0 0>;
	};
	led2:led@2 {
		compatible = "mediatek,blue";
		led_mode = <0>;
		data = <1>;
		pwm_config = <0 0 0 0 0>;
	};
	led3:led@3 {
		compatible = "mediatek,jogball-backlight";
		led_mode = <0>;
		data = <1>;
		pwm_config = <0 0 0 0 0>;
	};
	led4:led@4 {
		compatible = "mediatek,keyboard-backlight";
		led_mode = <0>;
		data = <1>;
		pwm_config = <0 0 0 0 0>;
	};
	led5:led@5 {
		compatible = "mediatek,button-backlight";
		led_mode = <0>;
		data = <1>;
		pwm_config = <0 0 0 0 0>;
	};
	led6:led@6 {
		compatible = "mediatek,lcd-backlight";
		led_mode = <5>;//prize-mod pengguangyi 20190112 use lcd backlight mode MT65XX_LED_MODE_CUST_LCM
		data = <1>;
		pwm_config = <0 3 0 0 0>;//prize-mod pengguangyi 20190112 use lcd backlight mode MT65XX_LED_MODE_CUST_LCM
	};
	vibrator0:vibrator@0 {
		compatible = "mediatek,vibrator";
		vib_timer = <25>;
		vib_limit = <9>;
		vib_vol= <9>;
	};

	usb_c_pinctrl:usb_c_pinctrl {
		compatible = "mediatek,usb_c_pinctrl";
	};
};

/* begin, prize-lifenfen-20181206, add for lcm gpio pinctl */
&prize_disp {
	pinctrl-names = "default", "lcm_rest_en0", "lcm_rest_en1","lcm_power_dm_en0","lcm_power_dm_en1";
	pinctrl-0 = <&lcm_pins_default>;
	pinctrl-1 = <&lcm_rest_en0>;
	pinctrl-2 = <&lcm_rest_en1>;
	pinctrl-3 = <&lcm_power_dm_en0>;
	pinctrl-4 = <&lcm_power_dm_en1>;
};

&pio {
	lcm_pins_default: displcm_default {
	};

	lcm_rest_en0: lcm_reset_en@0 {
	    pins_cmd_dat {
			pins = <PINMUX_GPIO45__FUNC_GPIO45>;
			slew-rate = <1>;
			output-low;
		};
	};
	lcm_rest_en1: lcm_reset_en@1 {
	    pins_cmd_dat {
			pins = <PINMUX_GPIO45__FUNC_GPIO45>;
			slew-rate = <1>;
			output-high;
		};
	};

	lcm_power_dm_en0: lcm_power_dm_en@0 {

	    pins_cmd_dat {
			pins = <PINMUX_GPIO159__FUNC_GPIO159>;
			slew-rate = <1>;
			output-low;
		};

	};
	lcm_power_dm_en1: lcm_power_dm_en@1 {
	    pins_cmd_dat {
			pins = <PINMUX_GPIO159__FUNC_GPIO159>;
			slew-rate = <1>;
			output-high;
		};
	};
};
/* end, prize-lifenfen-20181206, add for lcm gpio pinctl */
/* TOUCH start */
&touch {
	tpd-resolution = <1080 2340>;//prize-mod pengguangyi 20190119 modify for TP HX8112
	use-tpd-button = <0>;
	tpd-key-num = <3>;
	tpd-key-local= <139 172 158 0>;
	tpd-key-dim-local = <90 883 100 40 230 883 100 40 370 883 100 40 0 0 0 0>;
	tpd-max-touch-num = <5>;
	tpd-filter-enable = <1>;
	tpd-filter-pixel-density = <146>;
	tpd-filter-custom-prameters = <0 0 0 0 0 0 0 0 0 0 0 0>;
	tpd-filter-custom-speed = <0 0 0>;
	pinctrl-names = "default", "state_eint_as_int", "state_eint_output0", "state_eint_output1",
		"state_rst_output0", "state_rst_output1";
	pinctrl-0 = <&ctp_pins_default>;
	pinctrl-1 = <&ctp_pins_eint_as_int>;
	pinctrl-2 = <&ctp_pins_eint_output0>;
	pinctrl-3 = <&ctp_pins_eint_output1>;
	pinctrl-4 = <&ctp_pins_rst_output0>;
	pinctrl-5 = <&ctp_pins_rst_output1>;
	status = "okay";
};
&pio {
	ctp_pins_default: eint0default {
	};
	ctp_pins_eint_as_int: eint@0 {
		pins_cmd_dat {
			pins = <PINMUX_GPIO1__FUNC_GPIO1>;
			slew-rate = <0>;
			bias-disable;
		};
	};
	ctp_pins_eint_output0: eintoutput0 {
		pins_cmd_dat {
			pins = <PINMUX_GPIO1__FUNC_GPIO1>;
			slew-rate = <1>;
			output-low;
		};
	};
	ctp_pins_eint_output1: eintoutput1 {
		pins_cmd_dat {
			pins = <PINMUX_GPIO1__FUNC_GPIO1>;
			slew-rate = <1>;
			output-high;
		};
	};
	ctp_pins_rst_output0: rstoutput0 {
		pins_cmd_dat {
			pins = <PINMUX_GPIO158__FUNC_GPIO158>;//prize-mod pengguangyi 20190112 modify for TP focaltech_touch_V22
			slew-rate = <1>;
			output-low;
		};
	};
	ctp_pins_rst_output1: rstoutput1 {
		pins_cmd_dat {
			pins = <PINMUX_GPIO158__FUNC_GPIO158>;//prize-mod pengguangyi 20190112 modify for TP focaltech_touch_V22
			slew-rate = <1>;
			output-high;
		};
	};
};
/* TOUCH end */

&i2c6 {
	aw8898_smartpa@34 {
	    compatible = "awinic,aw8898_smartpa";
	    reg = <0x34>;
	    reset-gpio = <&pio 176 0>;
	    irq-gpio = <&pio 173 0>;
	    status = "okay";
	  };
  };

/* accdet start */
&accdet {
	/* accdet micbias voltage: 0x07,2.7v;0x05,2.5v;0x02,1.9v */
	accdet-mic-vol = <6>;
	headset-mode-setting = <0x500 0x500 1 0x1f0 0x800 0x800 0x20 0x44>;
	accdet-plugout-debounce = <1>;
	/*1:ACC mode, 2:low cost without in bias, 6:low cost with in bias*/
	accdet-mic-mode = <1>;
	/* eint_level_trigger: 8,LEVEL_LOW(default);4,LEVEL_HIGH;others,LEVEL_LOW */
	headset-eint-level-pol = <8>;
	/*0--MD_MAX--UP_MAX--DW_MAX*/
	headset-three-key-threshold = <0 80 220 400>;
	headset-three-key-threshold-CDD = <0 121 192 600>;
	/*0--MD_MAX--VOICE_MAX--UP_MAX--DW_MAX*/
	headset-four-key-threshold = <0 58 121 192 400>;
	/* ACCDET GPIO standardization ACC mode no use */
	pinctrl-names = "default", "state_eint_as_int";
	pinctrl-0 = <&accdet_pins_default>;
	pinctrl-1 = <&accdet_pins_eint_as_int>;
	status = "okay";
};
&pio {
	accdet_pins_default: accdetdefault {
	};
	accdet_pins_eint_as_int: accdeteint@0 {
		pins_cmd_dat {
			/*pins = <PINMUX_GPIO7__FUNC_GPIO7>;*/
			slew-rate = <0>;
			bias-disable;
		};
	};
};
/* accdet end */

&scp {
	core_1 = "enable";
	scp_sramSize = <0x00080000>;     /* scp_A_sram_size */
};

/* AUDIO GPIO standardization */
&audgpio {
	pinctrl-names = "aud_clk_mosi_off",
			"aud_clk_mosi_on",
			"aud_dat_mosi_off",
			"aud_dat_mosi_on",
			"aud_dat_miso_off",
			"aud_dat_miso_on",
			"aud_smartpa_off",
			"aud_smartpa_on",
			"vow_dat_miso_off",
			"vow_dat_miso_on",
			"vow_clk_miso_off",
			"vow_clk_miso_on";
	pinctrl-0 = <&aud_clk_mosi_off>;
	pinctrl-1 = <&aud_clk_mosi_on>;
	pinctrl-2 = <&aud_dat_mosi_off>;
	pinctrl-3 = <&aud_dat_mosi_on>;
	pinctrl-4 = <&aud_dat_miso_off>;
	pinctrl-5 = <&aud_dat_miso_on>;
	pinctrl-6 = <&aud_pins_smartpa_off>;
	pinctrl-7 = <&aud_pins_smartpa_on>;
	pinctrl-8 = <&vow_dat_miso_off>;
	pinctrl-9 = <&vow_dat_miso_on>;
	pinctrl-10 = <&vow_clk_miso_off>;
	pinctrl-11 = <&vow_clk_miso_on>;
	status = "okay";
};

&pio {
	aud_clk_mosi_off: aud_clk_mosi_off {
		pins_cmd0_dat {
			pins = <PINMUX_GPIO136__FUNC_GPIO136>;
		};
	};

	aud_clk_mosi_on: aud_clk_mosi_on {
		pins_cmd0_dat {
			pins = <PINMUX_GPIO136__FUNC_AUD_CLK_MOSI>;
		};
	};

	aud_dat_mosi_off: aud_dat_mosi_off {
		pins_cmd1_dat {
			pins = <PINMUX_GPIO138__FUNC_GPIO138>;
		};
		pins_cmd2_dat {
			pins = <PINMUX_GPIO139__FUNC_GPIO139>;
		};
	};

	aud_dat_mosi_on: aud_dat_mosi_on {
		pins_cmd1_dat {
			pins = <PINMUX_GPIO138__FUNC_AUD_DAT_MOSI0>;
		};
		pins_cmd2_dat {
			pins = <PINMUX_GPIO139__FUNC_AUD_DAT_MOSI1>;
		};
	};

	aud_dat_miso_off: aud_dat_miso_off {
		pins_cmd1_dat {
			pins = <PINMUX_GPIO142__FUNC_GPIO142>;
		};
		pins_cmd2_dat {
			pins = <PINMUX_GPIO143__FUNC_GPIO143>;
		};
	};

	aud_dat_miso_on: aud_dat_miso_on {
		pins_cmd1_dat {
			pins = <PINMUX_GPIO142__FUNC_AUD_DAT_MISO0>;
		};
		pins_cmd2_dat {
			pins = <PINMUX_GPIO143__FUNC_AUD_DAT_MISO1>;
		};
	};

	aud_pins_smartpa_off: aud_pins_smartpa_off {
		pins_cmd0_dat {
			pins = <PINMUX_GPIO174__FUNC_GPIO174>;
		};
		pins_cmd1_dat {
			pins = <PINMUX_GPIO170__FUNC_GPIO170>;
		};
		pins_cmd2_dat {
			pins = <PINMUX_GPIO171__FUNC_GPIO171>;
		};
		pins_cmd3_dat {
			pins = <PINMUX_GPIO172__FUNC_GPIO172>;
		};
	};

	aud_pins_smartpa_on: aud_pins_smartpa_on {
		pins_cmd0_dat {
			pins = <PINMUX_GPIO174__FUNC_I2S0_DI>;
		};
		pins_cmd1_dat {
			pins = <PINMUX_GPIO170__FUNC_I2S3_BCK>;
		};
		pins_cmd2_dat {
			pins = <PINMUX_GPIO171__FUNC_I2S3_LRCK>;
		};
		pins_cmd3_dat {
			pins = <PINMUX_GPIO172__FUNC_I2S3_DO>;
		};
	};

	vow_dat_miso_off: vow_dat_miso_off {
		pins_cmd1_dat {
			pins = <PINMUX_GPIO142__FUNC_GPIO142>;
		};
	};

	vow_dat_miso_on: vow_dat_miso_on {
		pins_cmd1_dat {
			pins = <PINMUX_GPIO142__FUNC_VOW_DAT_MISO>;
		};
	};

	vow_clk_miso_off: vow_clk_miso_off {
		pins_cmd3_dat {
			pins = <PINMUX_GPIO143__FUNC_GPIO143>;
		};
	};

	vow_clk_miso_on: vow_clk_miso_on {
		pins_cmd3_dat {
			pins = <PINMUX_GPIO143__FUNC_VOW_CLK_MISO>;
		};
	};
};
/* AUDIO end */

/* CONSYS GPIO standardization */
&pio {
	consys_pins_default: consys_default {
	};
	gpslna_pins_init: gpslna@0 {
		pins_cmd_dat {
			pins = <PINMUX_GPIO155__FUNC_GPIO155>;
			slew-rate = <0>;
			bias-disable;
			output-low;
		};
	};
	gpslna_pins_oh: gpslna@1 {
		pins_cmd_dat {
			pins = <PINMUX_GPIO155__FUNC_GPIO155>;
			slew-rate = <1>;
			output-high;
		};
	};
	gpslna_pins_ol: gpslna@2 {
		pins_cmd_dat {
			pins = <PINMUX_GPIO155__FUNC_GPIO155>;
			slew-rate = <1>;
			output-low;
		};
	};
	fmlna_pins_init: fmlna@0 {
		pins_cmd_dat {
			pins = <PINMUX_GPIO160__FUNC_GPIO160>;
			slew-rate = <0>;
			bias-disable;
			output-low;
		};
	};
	fmlna_pins_oh: fmlna@1 {
		pins_cmd_dat {
			pins = <PINMUX_GPIO160__FUNC_GPIO160>;
			slew-rate = <1>;
			output-high;
		};
	};
	fmlna_pins_ol: fmlna@2 {
		pins_cmd_dat {
			pins = <PINMUX_GPIO160__FUNC_GPIO160>;
			slew-rate = <1>;
			output-low;
		};
	};
};
&consys {
	pinctrl-names = "default", "gps_lna_state_init", "gps_lna_state_oh", "gps_lna_state_ol",
	"fm_lna_state_init", "fm_lna_state_oh", "fm_lna_state_ol";
	pinctrl-0 = <&consys_pins_default>;
	pinctrl-1 = <&gpslna_pins_init>;
	pinctrl-2 = <&gpslna_pins_oh>;
	pinctrl-3 = <&gpslna_pins_ol>;
        pinctrl-4 = <&fmlna_pins_init>;
        pinctrl-5 = <&fmlna_pins_oh>;
        pinctrl-6 = <&fmlna_pins_ol>;
	status = "okay";
};
/* CONSYS end */
/*zhengjiang.zhu@prize.Camera.Driver  2018/12/7  add for camera*/
/* CAMERA GPIO standardization */
&pio {
	camera_pins_cam0_rst_0: cam0@0 {
		pins_cmd_dat {
			pins = <PINMUX_GPIO101__FUNC_GPIO101>;
			slew-rate = <1>;
			output-low;
		};
	};
	camera_pins_cam0_rst_1: cam0@1 {
		pins_cmd_dat {
			pins = <PINMUX_GPIO101__FUNC_GPIO101>;
			slew-rate = <1>;
			output-high;
		};
	};
	camera_pins_cam0_pnd_0: cam0@2 {
		pins_cmd_dat {
			pins = <PINMUX_GPIO97__FUNC_GPIO97>;
			slew-rate = <1>;
			output-low;
		};
	};
	camera_pins_cam0_pnd_1: cam0@3 {
		pins_cmd_dat {
			pins = <PINMUX_GPIO97__FUNC_GPIO97>;
			slew-rate = <1>;
			output-high;
		};
	};
	camera_pins_cam1_rst_0: cam1@0 {
		pins_cmd_dat {
			pins = <PINMUX_GPIO102__FUNC_GPIO102>;
			slew-rate = <1>; /*direction 0:in, 1:out*/
			output-low;/*direction out used only. output_low or high*/
		};
	};
	camera_pins_cam1_rst_1: cam1@1 {
		pins_cmd_dat {
			pins = <PINMUX_GPIO102__FUNC_GPIO102>;
			slew-rate = <1>;
			output-high;
		};
	};
	camera_pins_cam1_pnd_0: cam1@2 {
		pins_cmd_dat {
			pins = <PINMUX_GPIO98__FUNC_GPIO98>;
			slew-rate = <1>;
			output-low;
		};
	};
	camera_pins_cam1_pnd_1: cam1@3 {
		pins_cmd_dat {
			pins = <PINMUX_GPIO98__FUNC_GPIO98>;
			slew-rate = <1>;
			output-high;
		};
	};
	camera_pins_cam2_rst_0: cam2@0 {
		pins_cmd_dat {
			pins = <PINMUX_GPIO109__FUNC_GPIO109>;
			slew-rate = <1>;
			output-low;
		};
	};
	camera_pins_cam2_rst_1: cam2@1 {
		pins_cmd_dat {
			pins = <PINMUX_GPIO109__FUNC_GPIO109>;
			slew-rate = <1>;
			output-high;
		};
	};
	camera_pins_cam2_pnd_0: cam2@3 {
		pins_cmd_dat {
			pins = <PINMUX_GPIO107__FUNC_GPIO107>;
			slew-rate = <1>;
			output-low;
		};
	};
	camera_pins_cam2_pnd_1: cam2@4 {
		pins_cmd_dat {
			pins = <PINMUX_GPIO107__FUNC_GPIO107>;
			slew-rate = <1>;
			output-high;
		};
	};
	camera_pins_cam0_vcamd_0: cam0@vcam0 {
		pins_cmd_dat {
			pins = <PINMUX_GPIO166__FUNC_GPIO166>;
			slew-rate = <1>;
			output-low;
		};
	};
	camera_pins_cam0_vcamd_1: cam0@vcam1 {
		pins_cmd_dat {
			pins = <PINMUX_GPIO166__FUNC_GPIO166>;
			slew-rate = <1>;
			output-high;
		};
	};
	camera_pins_cam2_vcamd_0: cam2@vcam0 {
		pins_cmd_dat {
			pins = <PINMUX_GPIO169__FUNC_GPIO169>;
			slew-rate = <1>;
			output-low;
		};
	};
	camera_pins_cam2_vcamd_1: cam1@vcam1 {
		pins_cmd_dat {
			pins = <PINMUX_GPIO169__FUNC_GPIO169>;
			slew-rate = <1>;
			output-high;
		};
	};
	camera_pins_cam2_vcama_0: cam1@vcam2 {
		pins_cmd_dat {
			pins = <PINMUX_GPIO169__FUNC_GPIO169>;
			slew-rate = <1>;
			output-low;
		};
	};
	camera_pins_cam2_vcama_1: cam1@vcam3 {
		pins_cmd_dat {
			pins = <PINMUX_GPIO169__FUNC_GPIO169>;
			slew-rate = <1>;
			output-high;
		};
	};
	camera_pins_cam0_mclk_on: camera_pins_cam0_mclk_on {
		pins_cmd_dat {
			pins = <PINMUX_GPIO99__FUNC_CMMCLK0>;
		};
	};
	camera_pins_cam0_mclk_off: camera_pins_cam0_mclk_off {
		pins_cmd_dat {
			pins = <PINMUX_GPIO99__FUNC_GPIO99>;
		};
	};
	camera_pins_cam1_mclk_off: camera_pins_cam1_mclk_off {
		pins_cmd_dat {
			pins = <PINMUX_GPIO100__FUNC_GPIO100>;
		};
	};
	camera_pins_cam1_mclk_on: camera_pins_cam1_mclk_on {
		pins_cmd_dat {
			pins = <PINMUX_GPIO100__FUNC_CMMCLK1>;
		};
	};
	camera_pins_cam2_mclk_off: camera_pins_cam2_mclk_off {
		pins_cmd_dat {
			pins = <PINMUX_GPIO108__FUNC_GPIO108>;
		};
	};
	camera_pins_cam2_mclk_on: camera_pins_cam2_mclk_on {
		pins_cmd_dat {
			pins = <PINMUX_GPIO108__FUNC_CMMCLK2>;
		};
	};
	/*zhengjiang.zhu@prize.Camera.Driver  2018/12/06  end  for main avdd*/
	camera_pins_cam0_vcama_0: cam0@vcam2 {
		pins_cmd_dat {
			pins = <PINMUX_GPIO178__FUNC_GPIO178>;
			slew-rate = <1>;
			output-low;
		};
	};
	camera_pins_cam0_vcama_1: cam0@vcam3 {
		pins_cmd_dat {
			pins = <PINMUX_GPIO178__FUNC_GPIO178>;
			slew-rate = <1>;
			output-high;
		};
	};
	/*zhengjiang.zhu@prize.Camera.Driver  2018/12/06  end  for main avdd*/
/*begin prize_add pengguangyi  20190114  add for Camera mipi switch*/
	cam_mipi_switch_en_0: cam_mipi_switch_en_0 {
		pins_cmd_dat {
			pins = <PINMUX_GPIO25__FUNC_GPIO25>;
			slew-rate = <1>;
			output-low;
		};
	};
	cam_mipi_switch_en_1: cam_mipi_switch_en_1 {
		pins_cmd_dat {
			pins = <PINMUX_GPIO25__FUNC_GPIO25>;
			slew-rate = <1>;
			output-high;
		};
	};
	cam_mipi_switch_sel_0: cam_mipi_switch_sel_0 {
		pins_cmd_dat {
			pins = <PINMUX_GPIO26__FUNC_GPIO26>;
			slew-rate = <1>;
			output-low;
		};
	};
	cam_mipi_switch_sel_1: cam_mipi_switch_sel_1 {
		pins_cmd_dat {
			pins = <PINMUX_GPIO26__FUNC_GPIO26>;
			slew-rate = <1>;
			output-high;
		};
	};
/*end prize_add pengguangyi  20190114  add for Camera mipi switch*/	
	/*prize  add  for sub avdd/dvdd by zhuzhengjiang    20190116-begin*/
	camera_pins_cam1_vcama_0: cam1@vcam4 {
		pins_cmd_dat {
			pins = <PINMUX_GPIO79__FUNC_GPIO79>;
			slew-rate = <1>;
			output-low;
		};
	};
	camera_pins_cam1_vcama_1: cam1@vcam5 {
		pins_cmd_dat {
			pins = <PINMUX_GPIO79__FUNC_GPIO79>;
			slew-rate = <1>;
			output-high;
		};
	};
	camera_pins_cam1_vcamd_0: cam0@vcam6 {
		pins_cmd_dat {
			pins = <PINMUX_GPIO159__FUNC_GPIO159>;
			slew-rate = <1>;
			output-low;
		};
	};
	camera_pins_cam1_vcamd_1: cam0@vcam7 {
		pins_cmd_dat {
			pins = <PINMUX_GPIO159__FUNC_GPIO159>;
			slew-rate = <1>;
			output-high;
		};
	};
	/*prize  add  for sub avdd/dvdd by zhuzhengjiang    20190116-end*/

	/*prize  add  for main-3 by zhuzhengjiang    20190127-begin*/
	camera_pins_cam3_rst_0: cam3@0 {
		pins_cmd_dat {
			pins = <PINMUX_GPIO112__FUNC_GPIO112>;
			slew-rate = <1>;
			output-low;
		};
	};
	camera_pins_cam3_rst_1: cam3@1 {
		pins_cmd_dat {
			pins = <PINMUX_GPIO112__FUNC_GPIO112>;
			slew-rate = <1>;
			output-high;
		};
	};
	camera_pins_cam3_pnd_0: cam3@2 {
		pins_cmd_dat {
			pins = <PINMUX_GPIO110__FUNC_GPIO110>;
			slew-rate = <1>;
			output-low;
		};
	};
	camera_pins_cam3_pnd_1: cam3@3 {
		pins_cmd_dat {
			pins = <PINMUX_GPIO110__FUNC_GPIO110>;
			slew-rate = <1>;
			output-high;
		};
	};

	camera_pins_cam3_vcama_0: cam3@vcam1 {
		pins_cmd_dat {
			pins = <PINMUX_GPIO28__FUNC_GPIO28>;
			slew-rate = <1>;
			output-low;
		};
	};
	camera_pins_cam3_vcama_1: cam3@vcam2 {
		pins_cmd_dat {
			pins = <PINMUX_GPIO28__FUNC_GPIO28>;
			slew-rate = <1>;
			output-high;
		};
	};
	/*prize  add  for main-3 by zhuzhengjiang    20190127-end*/
	camera_pins_default: camdefault {
	};
};
&kd_camera_hw1 {
	pinctrl-names = "default",
			"cam0_rst0", "cam0_rst1",
			"cam0_pnd0", "cam0_pnd1",
			"cam1_rst0", "cam1_rst1",
			"cam1_pnd0", "cam1_pnd1",
			"cam2_rst0", "cam2_rst1",
			"cam2_pnd0", "cam2_pnd1",
			"cam_ldo_vcamd_0", "cam_ldo_vcamd_1",
			"cam_ldo_main2_vcamd_0", "cam_ldo_main2_vcamd_1",
			"cam_ldo_main2_vcama_0", "cam_ldo_main2_vcama_1",
			"cam0_mclk_off", "cam0_mclk_on",
			"cam1_mclk_off", "cam1_mclk_on",
			"cam2_mclk_off", "cam2_mclk_on",
			/*zhengjiang.zhu@prize.Camera.Driver  2018/12/06  add  for main avdd*/
			"cam_ldo_vcama_0", "cam_ldo_vcama_1",
			/*begin prize_add pengguangyi  20190114  add for Camera mipi switch*/
			"cam_mipi_switch_en_0", "cam_mipi_switch_en_1",
			"cam_mipi_switch_sel_0", "cam_mipi_switch_sel_1",
			/*end prize_add pengguangyi  20190114  add for Camera mipi switch*/
			/*prize  add  for camera by zhuzhengjiang    20190127-begin*/
			// sub avdd/dvdd
			"cam_ldo_sub_vcama_0", "cam_ldo_sub_vcama_1",
			"cam_ldo_sub_vcamd_0", "cam_ldo_sub_vcamd_1",
                        //main-3
 			"cam3_rst0", "cam3_rst1",
			"cam3_pnd0", "cam3_pnd1", 
			"cam_ldo_sub2_vcama_0", "cam_ldo_sub2_vcama_1";
			/*prize  add  for camera by zhuzhengjiang    20190127-end*/
	pinctrl-0 = <&camera_pins_default>;
	pinctrl-1 = <&camera_pins_cam0_rst_0>;
	pinctrl-2 = <&camera_pins_cam0_rst_1>;
	pinctrl-3 = <&camera_pins_cam0_pnd_0>;
	pinctrl-4 = <&camera_pins_cam0_pnd_1>;
	pinctrl-5 = <&camera_pins_cam1_rst_0>;
	pinctrl-6 = <&camera_pins_cam1_rst_1>;
	pinctrl-7 = <&camera_pins_cam1_pnd_0>;
	pinctrl-8 = <&camera_pins_cam1_pnd_1>;
	pinctrl-9 = <&camera_pins_cam2_rst_0>;
	pinctrl-10 = <&camera_pins_cam2_rst_1>;
	pinctrl-11 = <&camera_pins_cam2_pnd_0>;
	pinctrl-12 = <&camera_pins_cam2_pnd_1>;
	pinctrl-13 = <&camera_pins_cam0_vcamd_0>;
	pinctrl-14 = <&camera_pins_cam0_vcamd_1>;
	pinctrl-15 = <&camera_pins_cam2_vcamd_0>;
	pinctrl-16 = <&camera_pins_cam2_vcamd_1>;
	pinctrl-17 = <&camera_pins_cam2_vcama_0>;
	pinctrl-18 = <&camera_pins_cam2_vcama_1>;
	pinctrl-19 = <&camera_pins_cam0_mclk_off>;
	pinctrl-20 = <&camera_pins_cam0_mclk_on>;
	pinctrl-21 = <&camera_pins_cam1_mclk_off>;
	pinctrl-22 = <&camera_pins_cam1_mclk_on>;
	pinctrl-23 = <&camera_pins_cam2_mclk_off>;
	pinctrl-24 = <&camera_pins_cam2_mclk_on>;
	/*zhengjiang.zhu@prize.Camera.Driver  2018/12/06  add  for main avdd*/
	pinctrl-25 = <&camera_pins_cam0_vcama_0>;
	pinctrl-26 = <&camera_pins_cam0_vcama_1>;
/*begin prize_add pengguangyi  20190114  add for Camera mipi switch*/
	pinctrl-27 = <&cam_mipi_switch_en_0>;
	pinctrl-28 = <&cam_mipi_switch_en_1>;
	pinctrl-29 = <&cam_mipi_switch_sel_0>;
	pinctrl-30 = <&cam_mipi_switch_sel_1>;
/*end prize_add pengguangyi  20190114  add for Camera mipi switch*/
	/*prize  add  for camera by zhuzhengjiang    20190127-begin*/
	//sub avdd/dvdd
	pinctrl-31 = <&camera_pins_cam1_vcama_0>;
	pinctrl-32 = <&camera_pins_cam1_vcama_1>;
	pinctrl-33 = <&camera_pins_cam1_vcamd_0>;
	pinctrl-34 = <&camera_pins_cam1_vcamd_1>;
        //main-3
	pinctrl-35 = <&camera_pins_cam3_rst_0>;
	pinctrl-36 = <&camera_pins_cam3_rst_1>;
	pinctrl-37 = <&camera_pins_cam3_pnd_0>;
	pinctrl-38 = <&camera_pins_cam3_pnd_1>;

	pinctrl-39 = <&camera_pins_cam3_vcama_0>;
	pinctrl-40 = <&camera_pins_cam3_vcama_1>;
	/*prize  add  for camera by zhuzhengjiang    20190127-end*/
	status = "okay";
};
/*zhengjiang.zhu@prize.Camera.Driver  2018/12/7  end for camera*/
/* UART GPIO */
&apuart0 {
	pinctrl-names = "uart0_gpio_default",
			"uart0_rx_set",
			"uart0_rx_clear",
			"uart0_tx_set",
			"uart0_tx_clear";
	pinctrl-0 = <&uart0_gpio_def_cfg>;
	pinctrl-1 = <&uart0_rx_set_cfg>;
	pinctrl-2 = <&uart0_rx_clr_cfg>;
	pinctrl-3 = <&uart0_tx_set_cfg>;
	pinctrl-4 = <&uart0_tx_clr_cfg>;
	status = "okay";
};

&pio {
	/* UART GPIO Settings - Start */
	/* UART0: rx set, rx clear, tx clear, tx clear*/
	uart0_gpio_def_cfg:uart0gpiodefault {

	};
	uart0_rx_set_cfg:uart0_rx_set@gpio95 {
		pins_cmd_dat {
			pins = <PINMUX_GPIO95__FUNC_URXD0>;
		};
	};
	uart0_rx_clr_cfg:uart0_rx_clear@gpio95 {
		pins_cmd_dat {
			pins = <PINMUX_GPIO95__FUNC_GPIO95>;
			slew-rate = <1>;
			output-high;
		};
	};
	uart0_tx_set_cfg:uart0_tx_set@gpio96 {
		pins_cmd_dat {
			pins = <PINMUX_GPIO96__FUNC_UTXD0>;
		};
	};
	uart0_tx_clr_cfg:uart0_tx_clear@gpio96 {
		pins_cmd_dat {
			pins = <PINMUX_GPIO96__FUNC_GPIO96>;
			slew-rate = <1>;
			output-high;
		};
	};
};/* UART GPIO end */

/* IRTX GPIO Start */
&irtx_pwm {
	pinctrl-names = "irtx_gpio_led_default", "irtx_gpio_led_set";
	pinctrl-0 = <&irtx_gpio_led_default>;
	pinctrl-1 = <&irtx_gpio_led_set>;
	status = "okay";
};
&pio {
	/* IRTX GPIO Settings -Start */
	/* default: GPIO0, output, high */
	irtx_gpio_led_default:irtx_gpio_led_def@gpio90 {
		pins_cmd_dat {
			pins = <PINMUX_GPIO90__FUNC_GPIO90>;
			slew-rate = <1>;
			bias-disable;
			output-low;
			input-schmitt-enable = <0>;
		};
	};

	irtx_gpio_led_set:irtx_gpio_led_set@gpio90 {
		pins_cmd_dat {
			pins = <PINMUX_GPIO90__FUNC_PWM_A>;
			slew-rate = <1>;
			output-high;
		};
	};
}; /* IRTX GPIO Settings -End */

&lk_charger {
/* begin, prize-sunshuai-20190325, delete for lk charging, evb setting*/
/* 	disable_charger;*/
/* end, prize-sunshuai-20190325, delete for lk charging, evb setting*/
};

&charger {
/* begin, prize-lifenfen-20181217, delete for charging, evb setting */
/*
	disable_charger;
*/
/* end, prize-lifenfen-20181217, delete for charging, evb setting */
};

&bat_gm30 {
/* begin, prize-lifenfen-20181217, modify for fg, evb setting */
/*
	DISABLE_MTKBATTERY = <(1)>;
*/
	DISABLE_MTKBATTERY = <(0)>;
/* end, prize-lifenfen-20181217, modify for fg, evb setting */
};

&mt6370_pmu {
	mt6370,intr_gpio_num = <10>; /* direct defined GPIO num */
	mt6370,intr_gpio = <&pio 10 0x0>;
	charger {
/* begin, prize-lifenfen-20181221, modify for mt6730 charger default cv setting */
                //cv = <4000000>;         /* uA */
		cv = <4380000>;		/* uA */
/* end, prize-lifenfen-20181221, modify for mt6730 charger default cv setting */
/* begin, prize-lifenfen-20181206, add for charger otg gpio pinctl */
		pinctrl-names = "default", "charger_otg_off", "charger_otg_on";
		pinctrl-0 = <&charger_otg_pins_default>;
		pinctrl-1 = <&charger_otg_pin_en0>;
		pinctrl-2 = <&charger_otg_pin_en1>;
		status = "okay";
/* end, prize-lifenfen-20181206, add for charger otg gpio pinctl */
	};
};

/* begin, prize-lifenfen-20181206, add for charger otg gpio pinctl */
&pio {
        charger_otg_pins_default: charger_otg_default {
        };

        charger_otg_pin_en0:  charger_otg_en@0 {
            pins_cmd_dat {
                        pins = <PINMUX_GPIO17__FUNC_GPIO17>;
                        slew-rate = <1>;
                        output-low;
                };
        };
        charger_otg_pin_en1:  charger_otg_en@1 {
            pins_cmd_dat {
                        pins = <PINMUX_GPIO17__FUNC_GPIO17>;
                        slew-rate = <1>;
                        output-high;
                };
        };
};
/* end, prize-lifenfen-20181206, add for charger otg gpio pinctl */

&mt6370_typec {
	mt6370pd,intr_gpio_num = <41>; /* direct defined GPIO num */
	mt6370pd,intr_gpio = <&pio 41 0x0>;
};

/* USB TYPEC GPIO start */
&pio {
	usb_default: usb_default {
	};

	gpio_redriver_c1_init: c1_init {
	};

	gpio_redriver_c1_low: c1_low {
	};

	gpio_redriver_c1_hiz: c1_highz {
	};

	gpio_redriver_c1_high: c1_high {
	};

	gpio_redriver_c2_init: c2_init {
	};

	gpio_redriver_c2_low: c2_low {
	};

	gpio_redriver_c2_hiz: gc2_highz {
	};

	gpio_redriver_c2_high: c2_high {
	};

	gpio_u3_switch_sel1: u3_sw_sel1 {
		pins_cmd_dat {
			pins = <PINMUX_GPIO177__FUNC_GPIO177>;
			slew-rate = <1>;
			output-low;
		};
	};

	gpio_u3_switch_sel2: u3_sw_sel2 {
		pins_cmd_dat {
			pins = <PINMUX_GPIO177__FUNC_GPIO177>;
			slew-rate = <1>;
			output-high;
		};
	};

	gpio_u3_switch_enable: u3_sw_en {
	};

	gpio_u3_switch_disable: u3_sw_dis {
	};
};

&usb_c_pinctrl {
	pinctrl-names = "usb_default",
		"redriver_c1_init",
		"redriver_c1_low",
		"redriver_c1_hiz",
		"redriver_c1_high",
		"redriver_c2_init",
		"redriver_c2_low",
		"redriver_c2_hiz",
		"redriver_c2_high",
		"u3_switch_sel1",
		"u3_switch_sel2",
		"u3_switch_enable",
		"u3_switch_disable";

	pinctrl-0 = <&usb_default>;
	pinctrl-1 = <&gpio_redriver_c1_init>;
	pinctrl-2 = <&gpio_redriver_c1_low>;
	pinctrl-3 = <&gpio_redriver_c1_hiz>;
	pinctrl-4 = <&gpio_redriver_c1_high>;
	pinctrl-5 = <&gpio_redriver_c2_init>;
	pinctrl-6 = <&gpio_redriver_c2_low>;
	pinctrl-7 = <&gpio_redriver_c2_hiz>;
	pinctrl-8 = <&gpio_redriver_c2_high>;
	pinctrl-9 = <&gpio_u3_switch_sel1>;
	pinctrl-10 = <&gpio_u3_switch_sel2>;
	pinctrl-11 = <&gpio_u3_switch_enable>;
	pinctrl-12 = <&gpio_u3_switch_disable>;
	status = "okay";

	usb_switch-data {
		en_pin_num = <0>;
		en_pin_val = <0>; /*DISABLE=0 ENABLE=1*/
		sel_pin_num = <177>;
		sel_pin_val = <1>; /*CC1=1, CC2=2*/
		c1_pin_num = <0>;
		c1_pin_val = <0>; /*Low=0, HighZ=1, High=2*/
		c2_pin_num = <0>;
		c2_pin_val = <0>;
	};
};

/* USB TYPEC GPIO end */

&charger {
	algorithm_name = "DualSwitchCharging";
	chg1_ta_ac_charger_current = <1700000>;
	chg2_ta_ac_charger_current = <1000000>;
};

&i2c6 {
	rt9465@4b {
		compatible = "richtek,rt9465";
		reg = <0x4b>;
		status = "okay";
		rt,en_gpio_num = <92>;
		rt,en_gpio = <&pio 92 0x0>;
		mt6306_en_pin = <1>;
		rt,intr_gpio_num = <69>; /* direct defined GPIO num */
		rt,intr_gpio = <&pio 69 0x0>;
		interrupt-names = "wdtmri";
		charger_name = "secondary_chg";
		ichg = <1500000>; /* uA */
		mivr = <4500000>; /* uV */
		cv = <4550000>; /* uV */
		ieoc = <700000>; /* uA */
		safety_timer = <12>; /* hour */
		en_st; /* safety timer */
		/* en_te; */
		en_wdt;
	};
};

&disp_aal0 {
	aal_support = <1>;
};

/* FINGERPRINT start */
&spi0 {
	#address-cells = <1>;
	#size-cells = <0>;

	fingerprint@0 {
		compatible = "goodix,goodix-fp";
		reg = <0>;
		spi-max-frequency = <8000000>;
		status = "okay";
		interrupt-parent = <&pio>;
		interrupts = <0 8 0 0>;
	};
};

&goodix_fp {
	pinctrl-names = "fingerprint_irq", "miso_spi", "miso_pullhigh", "miso_pulllow",
					"reset_high", "reset_low", "ldo_high", "ldo_low";
	pinctrl-0 = <&fingerprint_irq>;
	pinctrl-1 = <&fingerprint_miso_spi &fingerprint_csb_spi &fingerprint_mosi_spi &fingerprint_clk_spi>;
	pinctrl-2 = <&fingerprint_miso_pullhigh>;
	pinctrl-3 = <&fingerprint_miso_pulllow>;
	pinctrl-4 = <&fingerprint_reset_high>;
	pinctrl-5 = <&fingerprint_reset_low>;
	pinctrl-6 = <&fingerprint_ldo_high>;
	pinctrl-7 = <&fingerprint_ldo_low>;
	status = "okay";
};

&pio {
	fingerprint_irq: fingerprint_irq {
		pins_cmd_dat {
			pins = <PINMUX_GPIO0__FUNC_GPIO0>;
			slew-rate = <0>;
			bias-disable;
		};
	};

	fingerprint_miso_spi: state_miso_spi {
		pins_cmd_dat {
			pins = <PINMUX_GPIO85__FUNC_SPI0_MI>;
		};
	};

	fingerprint_miso_pullhigh: state_miso_pullhigh {
		pins_cmd_dat {
			pins = <PINMUX_GPIO85__FUNC_GPIO85>;
			slew-rate = <1>;
			output-high;
		};
	};

	fingerprint_miso_pulllow: state_miso_pulllow {
		pins_cmd_dat {
			pins = <PINMUX_GPIO85__FUNC_GPIO85>;
			slew-rate = <1>;
			output-low;
		};
	};

	fingerprint_csb_spi: state_csb_spi {
		pins_cmd_dat {
			pins = <PINMUX_GPIO86__FUNC_SPI0_CSB>;
		};
	};

	fingerprint_mosi_spi: state_mosi_spi {
		pins_cmd_dat {
			pins = <PINMUX_GPIO87__FUNC_SPI0_MO>;
		};
	};

	fingerprint_clk_spi: state_clk_spi {
		pins_cmd_dat {
			pins = <PINMUX_GPIO88__FUNC_SPI0_CLK>;
		};
	};

	fingerprint_reset_high: state_reset_high {
		pins_cmd_dat {
			pins = <PINMUX_GPIO175__FUNC_GPIO175>;
			slew-rate = <1>;
			output-high;
		};
	};

	fingerprint_reset_low: state_reset_low {
		pins_cmd_dat {
			pins = <PINMUX_GPIO175__FUNC_GPIO175>;
			slew-rate = <1>;
			output-low;
		};
	};

	fingerprint_ldo_high: state_ldo_high {
		pins_cmd_dat {
			pins = <PINMUX_GPIO80__FUNC_GPIO80>;
			slew-rate = <1>;
			output-high;
		};
	};

	fingerprint_ldo_low: state_ldo_low {
		pins_cmd_dat {
			pins = <PINMUX_GPIO80__FUNC_GPIO80>;
			slew-rate = <1>;
			output-low;
		};
	};
};
/* FINGERPRINT end */
//add by zyt liuyonglin A5 at 20190122 begin
&spi3 {
	#address-cells = <1>;
	#size-cells = <0>;
	veba5@0 {
		compatible = "zyt,veba5-spi";
		reg = <0>;
		spi-max-frequency = <27000000>;
		netlink-event = <30>;
		veba5,irq-gpio=<&pio 157 0>;
		status = "okay";		
	};
};

&veba5_spi {
	pinctrl-names = "default", "a5_reset_high", "a5_reset_low", "a5_power_high", "a5_power_low", "a5_irq_inpull", "a5_spi_csb_low", "a5_spi_csb_high", "a5_spi_clk", "a5_spi_miso", "a5_spi_mosi", "a5_gpio_csb_low", "a5_gpio_clk", "a5_gpio_miso", "a5_gpio_mosi", "a5_reset_in", "a5_wake_high", "a5_wake_low";
	pinctrl-0 = <&veba5_default>;
	pinctrl-1 = <&veba5_reset_high>;
	pinctrl-2 = <&veba5_reset_low>;
	pinctrl-3 = <&veba5_power_high>;
	pinctrl-4 = <&veba5_power_low>;
	pinctrl-5 = <&veba5_irq_inpull>;
	pinctrl-6 = <&veba5_spi_csb_low>;
	pinctrl-7 = <&veba5_spi_csb_high>;
	pinctrl-8 = <&veba5_spi_clk>;
	pinctrl-9 = <&veba5_spi_miso>;
	pinctrl-10 = <&veba5_spi_mosi>;
	pinctrl-11 = <&veba5_gpio_csb_low>;
	pinctrl-12= <&veba5_gpio_clk>;
	pinctrl-13 = <&veba5_gpio_miso>;
	pinctrl-14 = <&veba5_gpio_mosi>;
	pinctrl-15 = <&veba5_reset_in>;
    pinctrl-16 = <&veba5_wake_high>;
	pinctrl-17 = <&veba5_wake_low>;
	status = "okay";
};

&pio {
	veba5_default: state_default {

	};

	veba5_reset_high: state_a5_reset_high {
		pins_cmd_dat {
			pins = <PINMUX_GPIO156__FUNC_GPIO156>;
			slew-rate = <1>;
			output-high;
		};
	};

	veba5_reset_low: state_a5_reset_low {
		pins_cmd_dat {
			pins = <PINMUX_GPIO156__FUNC_GPIO156>;
			slew-rate = <1>;
			output-low;
		};
	};

	veba5_power_high: state_a5_power_high {
		pins_cmd_dat {
			pins = <PINMUX_GPIO179__FUNC_GPIO179>;
			slew-rate = <1>;
			output-high;			
		};
	};

	veba5_power_low: state_a5_power_low {
		pins_cmd_dat {
			pins = <PINMUX_GPIO179__FUNC_GPIO179>;
			slew-rate = <1>;
			output-low;
		};
	};
	veba5_irq_inpull: state_a5_input_pull {
		pins_cmd_dat {
			pins = <PINMUX_GPIO157__FUNC_GPIO157>;
			slew-rate = <0>;
			output-low;
			bias-pull-down = <0>;
		};
	};
		
	veba5_spi_csb_low: state_a5_spi_csb_low {
		pins_cmd_dat {
			pins = <PINMUX_GPIO22__FUNC_SPI3_CSB>;
			slew-rate = <1>;
			output-low;
		};
	};
	veba5_spi_csb_high: state_a5_spi_csb_high {
		pins_cmd_dat {
			pins = <PINMUX_GPIO22__FUNC_SPI3_CSB>;
			bias-pull-up = <00>;
		};
	};

	veba5_spi_clk: state_a5_spi_clk {
		pins_cmd_dat {
			pins = <PINMUX_GPIO24__FUNC_SPI3_CLK>;
			bias-pull-down = <00>;
		};
	};

	veba5_spi_miso: state_a5_spi_miso {
		pins_cmd_dat {
			pins = <PINMUX_GPIO21__FUNC_SPI3_MI>;
			bias-pull-up = <00>;			
		};
	};

	veba5_spi_mosi: state_a5_spi_mosi {
		pins_cmd_dat {
			pins = <PINMUX_GPIO23__FUNC_SPI3_MO>;
			bias-pull-up = <00>;
		};
	};
//////////////////////////////////////////////////////////////////////////	
	veba5_gpio_csb_low: state_a5_gpio_csb_low {
		pins_cmd_dat {
			pins = <PINMUX_GPIO22__FUNC_GPIO22>;
		};
	};

	veba5_gpio_clk: state_a5_gpio_clk {
		pins_cmd_dat {
			pins = <PINMUX_GPIO24__FUNC_GPIO24>;
		};
	};

	veba5_gpio_miso: state_a5_gpio_miso {
		pins_cmd_dat {
			pins = <PINMUX_GPIO21__FUNC_GPIO21>;
		};
	};

	veba5_gpio_mosi: state_a5_gpio_mosi {
		pins_cmd_dat {
			pins = <PINMUX_GPIO23__FUNC_GPIO23>;
		};
	};
	veba5_reset_in: state_a5_reset_in {
		pins_cmd_dat {
			pins = <PINMUX_GPIO156__FUNC_GPIO156>;
			slew-rate = <0>;
			output-high;
			bias-pull-up;
		};
	};
    
    veba5_wake_high: state_a5_wake_high {
		pins_cmd_dat {
			pins = <PINMUX_GPIO91__FUNC_GPIO91>;
			slew-rate = <1>;
			output-high;
		};
	};

	veba5_wake_low: state_a5_wake_low {
		pins_cmd_dat {
			pins = <PINMUX_GPIO91__FUNC_GPIO91>;
			slew-rate = <1>;
			output-low;
		};
	};
};
//add by zyt liuyonglin A5 at 20190122 end
/*zhengjiang.zhu@prize.Camera.Driver  2018/09/30  add for STEP_MOTOR*/ 
&prize_stepper_motor {
	pinctrl-names = "default", "step_low", "step_high", "dir_low", "dir_high","sleep_low", "sleep_high","step_pwm",
	                "enable_low","enable_high","curren_m1_high","curren_m1_low","curren_m0_high","curren_m0_low";
	pinctrl-0 = <&steppin_default>;
	pinctrl-1 = <&steppin_low>;
	pinctrl-2 = <&steppin_high>;
	pinctrl-3 = <&dirpin_low>;
	pinctrl-4 = <&dirpin_high>;
	pinctrl-5 = <&sleeppin_low>;
	pinctrl-6 = <&sleeppin_high>;
	pinctrl-7 = <&steppwm_high>;
	pinctrl-8 = <&enablepin_low>;
	pinctrl-9 = <&enablepin_high>;

	pinctrl-10 = <&curren_m1_pin_high>;
	pinctrl-11 = <&curren_m1_pin_low>;
	pinctrl-12 = <&curren_m0_pin_high>;
	pinctrl-13 = <&curren_m0_pin_low>;
	status = "okay";
};

&pio {
	steppin_default: steppin_default {
	};
	steppin_low: steppin_low {
		pins_cmd_dat {
			pins = <PINMUX_GPIO156__FUNC_GPIO156>;
			slew-rate = <1>;
			output-low;
		};
	};

	steppin_high: step_high {
		pins_cmd_dat {
			pins = <PINMUX_GPIO156__FUNC_GPIO156>;
			slew-rate = <1>;
			output-high;
		};
	};
	dirpin_low: dir_low {
		pins_cmd_dat {
			pins = <PINMUX_GPIO23__FUNC_GPIO23>;
			slew-rate = <1>;
			output-low;
		};
	};
	dirpin_high: dir_high {
		pins_cmd_dat {
			pins = <PINMUX_GPIO23__FUNC_GPIO23>;
			slew-rate = <1>;
			output-high;
		};
	};
	sleeppin_low: sleep_low {
		pins_cmd_dat {
			pins = <PINMUX_GPIO22__FUNC_GPIO22>;
			slew-rate = <1>;
			output-low;
		};
	};
	sleeppin_high: sleep_high {
		pins_cmd_dat {
			pins = <PINMUX_GPIO22__FUNC_GPIO22>;
			slew-rate = <1>;
			output-high;
		};
	};
	steppwm_high: steppwm_high {
		pins_cmd_dat {
			pins = <PINMUX_GPIO90__FUNC_PWM_A>;
		};
	};
	enablepin_low: enablepin_low {
		pins_cmd_dat {
			pins = <PINMUX_GPIO25__FUNC_GPIO25>;
			slew-rate = <1>;
			output-low;
		};
	};
	enablepin_high: enablepin_high {
		pins_cmd_dat {
			pins = <PINMUX_GPIO25__FUNC_GPIO25>;
			slew-rate = <1>;
			output-high;
		};
	};
	
	curren_m1_pin_high: curren_m1_pin_high {
		pins_cmd_dat {
			pins = <PINMUX_GPIO21__FUNC_GPIO21>;
			slew-rate = <1>;
			output-high;
		};
	};
	
	curren_m1_pin_low: curren_m1_pin_low {
		pins_cmd_dat {
			pins = <PINMUX_GPIO21__FUNC_GPIO21>;
			slew-rate = <1>;
			output-low;
		};
	};

	curren_m0_pin_high: curren_m0_pin_high {
		pins_cmd_dat {
			pins = <PINMUX_GPIO20__FUNC_GPIO20>;
			slew-rate = <1>;
			output-high;
		};
	};

	curren_m0_pin_low: curren_m0_pin_low {
		pins_cmd_dat {
			pins = <PINMUX_GPIO20__FUNC_GPIO20>;
			slew-rate = <1>;
			output-low;
		};
	};
};

/*zhengjiang.zhu@prize.Camera.Driver  2018/09/30 end for STEP_MOTOR*/ 
/*zhengjiang.zhu@prize.Camera.Driver  2018/09/30  add for hall1120*/ 
&i2c6 {
    status = "ok";
    /* mxm Team add Start */
    magnachip@0c{
        compatible = "magnachip,mxm1120,up";
        reg = <0x0c>;
        //vdd-supply = <&pm8150_l9>;////<&pm8998_l19>;
        //vio-supply = <&pm8150_s4>;////<&pm8998_s4>;
        magnachip,init-interval = <200>;
        //pins = "gpio95";
        mxm,id = <1>;
        //magnachip,use-hrtimer;
    };

    magnachip@0e{
        compatible = "magnachip,mxm1120,down";
        reg = <0x0e>;
        //vdd-supply = <&pm8150_l9>;////<&pm8998_l19>;
        //vio-supply = <&pm8150_s4>;////<&pm8998_s4>;
        magnachip,init-interval = <200>;
        //pins = "gpio95";
        mxm,id = <2>;
        //magnachip,use-hrtimer;
    };
    /* mxm Team add End */
};
/*zhengjiang.zhu@prize.Camera.Driver  2018/09/30  end for hall1120*/ 
/* begin, prize-lifenfen-20181219, add for hall */
&hall_1 {
        pinctrl-names = "default", "hall_eint";
        pinctrl-0 = <&hall_eint_default>;
        pinctrl-1 = <&hall_eint_as_int>;
        interrupt-parent = <&pio>;
        interrupts = <6 2 6 0>;
        debounce = <6 0>;
        status = "okay";
};

&pio {
        hall_eint_default: halldefault {
        };
        hall_eint_as_int: halleint {
                pins_cmd_dat {
                        pins = <PINMUX_GPIO6__FUNC_GPIO6>;
                        slew-rate = <0>;
                        bias-disable;
                };
        };
};
/* end, prize-lifenfen-20181219, add for hall */

/* begin, prize-lifenfen-20190103, add for wireless power receiver mt5715 */
&i2c3 {
        MT5715_receiver@56 {
            compatible = "MT5715_receiver";
            reg = <0x56>;
            irq-gpio = <&pio 8 0>;
            dc-gpio = <&pio 13 0>;
            status = "okay";
          };
};
/* end, prize-lifenfen-20190103, add for wireless power receiver mt5715 */

/*start prize-sunshuai-20190126, add for Wireless NE6153 support  */
&i2c3 {
	wrx: wrx@61 {
		compatible = "newedge,ne6153";
		reg = <0x61>;
		wrx_irq_debounce = <256000>;
		};
};
/*end prize-sunshuai-20190126, add for Wireless NE6153 support */

#include <evb6771_64_emmc/cust.dtsi>
/*End of this file, DO NOT ADD ANYTHING HERE*/
